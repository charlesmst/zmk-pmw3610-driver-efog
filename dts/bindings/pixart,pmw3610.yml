## dts/bindings/pixart,pmw3610.yml
```yaml
description: |
  Sensor driver for the pixart PMW3610 mouse sensor 

compatible: "pixart,pmw3610"

include: spi-device.yaml

properties:
  irq-gpios:
    type: phandle-array
    required: true
  rst-gpios:
    type: phandle-array
  cpi:
    type: int
    default: 600
    description: "CPI value (Range: 200 - 3200, Step: 200)"
  evt-type:
    type: int
    required: true
  x-input-code:
    type: int
    required: true
  y-input-code:
    type: int
    required: true
  force-awake:
    type: boolean
  force-high-performance:
    type: boolean
  enable-pm-support:
    type: boolean
  xy-swap:
    type: boolean
  x-invert:
    type: boolean
  y-invert:
    type: boolean
  init-retry-count:
    type: int
    default: 3
    description: "Number of initialization retry attempts"
  init-retry-interval:
    type: int
    default: 100
    description: "Interval between initialization retries in milliseconds"
  usb-rate-ms:
    type: int
    description: |
      PERFORMANCE register run-rate (ms) used as the boot default.
      2 = ~500 Hz, 4 = 250 Hz, 8 = 125 Hz.
  ble-rate-ms:
    type: int
    description: |
      Optional BLE run-rate hint for configs that use out-of-tree transport switching.
      2 = ~500 Hz, 4 = 250 Hz, 8 = 125 Hz.
  rate-cycle-gpios:
    type: phandle-array
    description: Optional GPIO for a hardware rate-cycle button (cycles report interval locally)
  rate-cycle-rates-ms:
    type: array
    description: Ordered list of report-interval values (ms) to cycle through (e.g. 8 4 2)
```
